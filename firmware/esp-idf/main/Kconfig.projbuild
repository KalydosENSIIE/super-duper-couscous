## firmware/esp-idf/main/Kconfig.projbuild
```kconfig
# put here your custom config value
menu "Super-Duper Configuration"

    menu "WiFi Configuration"
        config ESP_WIFI_SSID
            string "WiFi SSID"
            default "myssid"
            help
                SSID (network name) for the esp32 to connect to.

        config ESP_WIFI_PASSWORD
            string "WiFi Password"
            default "mypassword"
            help
                WiFi password (WPA or WPA2) for the esp32 to use.

        config ESP_WIFI_RECONNECT_MAXIMUM_RETRY
            int "WiFi connect retries"
            default 5
            help
                Number of subsequent times to retry connecting to 
                WiFi AP upon disconnection.
    endmenu

    config ESP_MEASUREMENT_INTERVAL_MS
        int "Energy measurement delay interval (ms)"
        default 500
        help
            Time delay between each query to the PZEM004t module. In milliseconds.
    
    config ESP_MQTT_BROKER_URL
        string "MQTT broker URL"
        default ""
        help
            URL of the MQTT broker to connect to.

endmenu
```
